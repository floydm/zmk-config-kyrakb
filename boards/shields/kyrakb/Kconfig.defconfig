## boards/shields/kyrakb/Kconfig.defconfig
```kconfig
if SHIELD_KYRAKB_LEFT

config ZMK_KEYBOARD_NAME
    default "KyraKb"

config ZMK_STUDIO
    bool
    default y

config ZMK_STUDIO_RPC_USB_UART
    bool
    default y

config ZMK_SPLIT_ROLE_CENTRAL
    default y

endif # SHIELD_KYRAKB_LEFT

if SHIELD_KYRAKB_LEFT || SHIELD_KYRAKB_RIGHT

config ZMK_SPLIT
    default y

endif # SHIELD_KYRAKB_LEFT || SHIELD_KYRAKB_RIGHT
```

## boards/shields/kyrakb/Kconfig.shield
```kconfig
config SHIELD_KYRAKB_LEFT
    def_bool $(shields_list_contains,kyrakb_left)

config SHIELD_KYRAKB_RIGHT
    def_bool $(shields_list_contains,kyrakb_right)
```
